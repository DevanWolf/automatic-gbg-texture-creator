/* Copyright 2022 Raymond Cardillo dba Cardillo's Creations, LLC

Licensed under the Apache License, Version 2.0 (the "License");
you may not use this file except in compliance with the License.
You may obtain a copy of the License at

	http://www.apache.org/licenses/LICENSE-2.0

Unless required by applicable law or agreed to in writing, software
distributed under the License is distributed on an "AS IS" BASIS,
WITHOUT WARRANTIES OR CONDITIONS OF ANY KIND, either express or implied.
See the License for the specific language governing permissions and
limitations under the License.

////////
agbgtc_tinyusb.ino
////////

Automatic Game Builder Garage Texture Creator
TinyUSB variant tested on Seeeduino XIAO.

See README.md for more details.

Requirements:
- Arduino IDE = v1.8.0 or later
- Seeeduino SAMD Boards = v1.8.3 // DO NOT USE v1.8.4 and later because of a breaking change involving TinyUSB
- Adafruit_TinyUSB = v0.10.5 // DO NOT USE v1.x.x-v2.x.x until Seeeduino updates their board library (breaking change)

Author of TinyUSB variant (tested on Seeeduino XIAO):
Ray Cardillo / LongToothGamer
https://LongToothGamer.com
https://youtube.com/channel/UC8nJI40ZJ2C682oAsB16gCA
Speed improvements by Sobble Entertainment Inc.
https://geocities.ws/devan
https://youtube.com/devanwolf1

////////*/

#include "src/TUAbsMouse.h"

#define START_PIN 2


const PROGMEM byte images[][4097] =
{
/* Replace the example image data with your own image data below (from the generated CSV files).
	 See GBG_Texture_Builder in the `utils` folder.

	 The data format is currently:
	 [0]			= Most common pixel color (used to fill background before drawing other pixels).
	 [1-4097] = [64][64] data [X][Y] representing the color of each pixel in the texture.

	 EXAMPLES INCLUDED BELOW:
	 Author: LongToothGamer							Title: Test Diagnostic Pattern
	 Author: LongToothGamer							Title: Test Data Color Cube
	 Author: Sobble Entertainment Inc.	Title: Temporary Profile Icon
	 Author: LongToothGamer							Title: Long Tooth Gamer Logo
	 Author: Colin Lloyd								Source: https://unsplash.com/photos/suj3od1uMv8
*/
{
	// TEST DIAGNOSTIC PATTERN
	47,
	16,16,01,01,01,01,01,01,47,47,47,47,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16,
	16,16,01,01,01,47,47,47,47,47,47,47,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16,
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	32,32,02,02,47,47,47,47,47,47,47,47,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32
},
{
	// TEST DATA COLOR CUBE
	0,27,27,27,27,27,27,27,27,27,27,27,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111
},
{
	// Sobble Entertainment Inc.'s temporary profile icon
	2,66,66,66,66,66,66,66,66,66,66,66,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81
},
{
	// LONG TOOTH GAMER LOGO (LongToothGamer.com)
	47,47,47,47,47,47,47,47,47,47,47,47,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47
},
{
	// EYEBALL from Colin Lloyd on Unsplash
	74,87,14,132,42,87,87,59,42,132,42,132,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87
}
};
const byte NUM_TEXTURES = sizeof(images)/4097;


bool usedColors[135];


void clickCloseWindow() {
  // Click on the "X" to exit the currently open window
  TUAbsMouse.clickMouse(1222, 56);
}


void pickColor(byte color_pos) {
  int column = color_pos % 15;
  int row = color_pos / 15;
  int pos_x = 84+(column*48)+((column/3)*16);
  int pos_y = 175+(row*48)+((row/3)*16);

  TUAbsMouse.clickMouse(1187, 544);     // Mouse click to open "Palette gear tool/Colour Palette"
  TUAbsMouse.clickMouse(pos_x, pos_y);  // Move mouse to color coords. and click on it
  clickCloseWindow();
}


// the setup function runs once when you press reset or power the board
void setup()
{
	// Set up button, pullup opposite to active state
	pinMode(START_PIN, INPUT_PULLDOWN);

	TUAbsMouse.begin();

	// wait until device mounted
	while( !USBDevice.mounted() )
		delay(1);

	digitalWrite(LED_BUILTIN, LOW);
	
	// wait until button is pressed
	while(!( digitalRead(START_PIN) and TUAbsMouse.ready() ))
		// poll gpio once each 1 ms
		delay(1);
	
	// indicate that we're alive and working
	digitalWrite(LED_BUILTIN, HIGH);

	for (byte n=0; n<NUM_TEXTURES; n++) {
		// Rehome for every texture in case the screen is accidentally touched
		TUAbsMouse.home();

		// Create a new Texture Nodon and get ready to plot the pixels=
		// Move to magnify plus button
		TUAbsMouse.moveTo(948, 694);

		for (byte i=0; i<(n==0?16:3); i++) { // assume the worst case on the first pass and zoom in enough to force the auto scale, after the first case we just need to magnify enough to cause the auto scale again
			TUAbsMouse.clickMouse();
			delayMicroseconds(16667); // extra delay to allow UI to update
		}

		TUAbsMouse.clickMouse(362, 692); // Objects
		TUAbsMouse.clickMouse(362, 332); // Special Objects
		TUAbsMouse.clickMouse(488, 572); // Texture
		delay(250); // A delay that is required to be sure the nodon gear icon is being displayed
		TUAbsMouse.clickMouse(550, 575); // Edit Texture Gear icon

		// Reset the processed colors indicators
		memset(usedColors, false, sizeof usedColors);

		// Get first color from the image data.
		// It represents the most used color and is used as the Background color.
		byte baseColor = pgm_read_byte_near(&images[n][0]);

		// As new textures has a transparent background we don't have to fill-bucket the canvas if the most used color is "transparent"
		if (baseColor != 47) {
			pickColor(baseColor);						 // Get color from the Palette
			TUAbsMouse.clickMouse(958, 268); // Mouse click on "Bucket Tool"
			TUAbsMouse.clickMouse(820, 280); // Fill the background on the canvas
			TUAbsMouse.clickMouse(991, 196); // Mouse click on "Pencil Tool"
		}

		// Remember that we already used this color
		usedColors[baseColor] = true;

		if (n==0)
			// Only click on pixel brush first time when creating multiple textures
			TUAbsMouse.clickMouse(940, 375); // Mouse click on "Pixel Brush"

		for (word t=1; t<4097; t++) {
			// get the target pixel color from the image data at the current index
			byte targetPixelColor = pgm_read_byte_near(&images[n][t]);

			// only process the color if we haven't already processed it
			if (!usedColors[targetPixelColor]) {
				// Remember that we already used/processed this color
				usedColors[targetPixelColor] = true;

				// Pick the color from the Palette
				pickColor(targetPixelColor);

				bool drag = false;
				// go through the remaining rows - wrapping around at the end of each line
				for (word c=t; c<4097; c++) {
					byte cPosX = (c-1) % 64;

					byte currentPixelColor = pgm_read_byte_near(&images[n][c]);
					if (currentPixelColor == targetPixelColor) {
						byte nextPixelColor = pgm_read_byte_near(&images[n][c+1]);
						byte cPosY = (c-1) / 64;
						// move to the pixel location - current pixel location matches target
						if (nextPixelColor == targetPixelColor and cPosX < 63) {
							if (!drag) {
								drag = true;
								TUAbsMouse.moveTo(340+(cPosX*8), 158+(cPosY*8));

								// make sure the button is pressed - current pixel color matches
								TUAbsMouse.mouseButtonPress();
							}
						} else if (drag) {
							drag = false;
							TUAbsMouse.moveTo(340+(cPosX*8), 158+(cPosY*8));
							// release the button - next pixel color doesn't match
							TUAbsMouse.mouseButtonRelease();
						}
						else
							TUAbsMouse.clickMouse(340+(cPosX*8), 158+(cPosY*8));
					}
				}
			}
		}
		// Done with this Texture Nodon
		clickCloseWindow();

		// Let the display finish updating
		delay(250);
	}

}


void loop()
{
	// Turn LED on (LOW on Seeeduino XIAO)
	digitalWrite(LED_BUILTIN, LOW);
	delay(750);
	// Turn LED off (HIGH on Seeeduino XIAO)
	digitalWrite(LED_BUILTIN, HIGH);
	delay(750);
}